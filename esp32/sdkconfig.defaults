## esp32/sdkconfig.defaults
```kconfig
# --- Bluetooth: NimBLE, solo periférico ---
CONFIG_BT_ENABLED=y
CONFIG_BT_NIMBLE_ENABLED=y
CONFIG_BT_NIMBLE_ROLE_PERIPHERAL=y
CONFIG_BT_NIMBLE_ROLE_BROADCASTER=y
CONFIG_BT_NIMBLE_ROLE_CENTRAL=n
CONFIG_BT_NIMBLE_ROLE_OBSERVER=n
CONFIG_BT_NIMBLE_MAX_CONNECTIONS=1
CONFIG_BT_NIMBLE_EXT_ADV=n

# --- USB HID (TinyUSB) ---
CONFIG_TINYUSB_HID_COUNT=1
```
